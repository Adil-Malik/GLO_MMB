/* 
Adil Malik 06/01/2014
GLO: The Midnight Message Board
V1
*/
byte font [][8] =
{
	
	{0x00, 0x00, 0x00, 0x00, 0x00, 0x00, 0x00, 0x00},	// Char 032 ( )
	{0x00, 0x00, 0x2E, 0x00, 0x00, 0x00, 0x00, 0x00},	// Char 033 (!)
	{0x00, 0x03, 0x00, 0x03, 0x00, 0x00, 0x00, 0x00},	// Char 034 (")
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	{0x02, 0x03, 0x01, 0x03, 0x02, 0x03, 0x01, 0x00}	// Char 126 (~)
	
};
int ColumnSteps = 20;//Steps Between Columns of a single Character
int CharSteps = 20; //Steps Between Character
int Speed = 5; //Motor Time between pulses (Speed)
const int Columns = 6; // Number of columns in a single character
int latchPin = 8;
int clockPin = 11;
int dataPin = 10; 
int OEPin = 9; // Output Enable
int MCPin = 12; //Master Clear pin
int Enmtr = 4; //Motor Enable
int Dirmtr = 7; //Motor Direction Pin
int Stepmtr = 2; // Motor Step Pin
int i, j, k ,l = 0;
int BytesReceived;
int CharLine = 36; //How many Chars per line, change this as per your display size
char data[CharLine]; //Array that stores the data we send via Serial Port, its max length is set to whats possilbe see on line 1
char data2[CharLine]; //Array that stores data for line 2



void setup() {
  //set pins to output so you can control the shift register
  pinMode(latchPin, OUTPUT);
  pinMode(clockPin, OUTPUT);
  pinMode(dataPin, OUTPUT);
  pinMode(MCPin, OUTPUT);
  pinMode(OEPin, OUTPUT);
  pinMode(Dirmtr, OUTPUT);
  pinMode(Enmtr, OUTPUT);
  pinMode(Stepmtr, OUTPUT);
  analogWrite(OEPin, 0); //Set the Brightness on LEDs, you can use this to shroten or increase the Fade Time.(0==MAX, 255==MIN).
  Serial.begin(9600);
  Serial.println("Serial conection started, waiting for instructions...");

}

void loop() {

 SerialRead();  //read serial data and store character in array
 WriteOut_1(data); //First line of text
 WriteOut_2(data2);//Second line of text



}





void WriteOut_2(char message[]){


  int messageLth = strlen(message); //Find the messages length.


  for(j=0; j<=messageLth-1; j++){ //Go through each character in the message.

    int Character = message[j] - 32;//reads and stores the ASCII value of the current Character we are dealing with and -32 so the char correspnds to our array.



    for(i=0;i<Columns;i++){//Go through each column in each character.
      ClearMem(); // clears the shift register so the data doesnt overflow into the other SR
      digitalWrite(latchPin, LOW);

      shiftOut(dataPin, clockPin, MSBFIRST, (font[Character][i])>>2); //Shiftup by 2 as only 6 leds are connected to Shift Register 2
      shiftOut(dataPin, clockPin, MSBFIRST, ((B00000000) | ((font[Character][i])<<6))); //Display the first 2 bits of a column on Shift Register 1's A6 and A7. We are splitting the byte. B11001101, the first register displays the first 2 bits, ie B00000011, and the second shfit register displays the rest of the original byte, shifted up by 2 ie,B00110100   

      digitalWrite(latchPin, HIGH); 


      MotorFWD(ColumnSteps);//Move between Columns of a character
      ClearMem();
    }
    MotorFWD(CharSteps); //Move between characters

  }
  ClearMem();
  MotorRtrn((messageLth*Columns*ColumnSteps)+(CharSteps*messageLth)); //Calculate the steps back to "Home"
  memset(data2, 0, strlen(data2)); //Clear the aray (kills the loop)


}

void WriteOut_1(char message[]){


  int messageLth = strlen(message); //Find the messages length.


  for(j=0; j<=messageLth-1; j++){ //Go through each character in the message.

    int Character = message[j] - 32;//reads and stores the ASCII value of the current Character we are dealing with and -32 so the char correspnds to our array.



    for(i=0;i<Columns;i++){//Go through each column in each character.
      ClearMem(); // clears the shift register so the data doesnt overflow into the other SR
      digitalWrite(latchPin, LOW);

      shiftOut(dataPin, clockPin, MSBFIRST, (font[Character][i])); //Shiftup by 2 as only 6 leds are connected to Shift Register 2
     // shiftOut(dataPin, clockPin, MSBFIRST, ((B00000000) | ((font[Character][i])<<6))); //Display the first 2 bits of a column on Shift Register 1's A6 and A7. We are splitting the byte. B11001101, the first register displays the first 2 bits, ie B00000011, and the second shfit register displays the rest of the original byte, shifted up by 2 ie,B00110100   

      digitalWrite(latchPin, HIGH); 


      MotorFWD(ColumnSteps);//Move between Columns of a character
      ClearMem();
    }
    MotorFWD(CharSteps); //Move between characters

  }
  ClearMem();
  MotorRtrn((messageLth*Columns*ColumnSteps)+(CharSteps*messageLth)); //Calculate the steps back to "Home"
  memset(data, 0, strlen(data)); //Clear the aray (kills the loop)


}




void ClearMem(){ //Clear both Shift Registers.
  digitalWrite(MCPin,LOW);
  delay(10); 
  digitalWrite(MCPin,HIGH);
}

void SerialRead(){
  if(Serial.available() > 0)
  {
    BytesReceived = Serial.readBytesUntil (13,data,CharLine-1); //Read 35 Bytes from the buffer or untill ASCII Char 13 found. Store in array "data" 
    data[BytesReceived] = 0; // add a 0 terminator 
    Serial.println(data);
    delay(100);
    BytesReceived = Serial.readBytesUntil (13,data2,CharLine-1); //Read 35 Bytes from the buffer or untill ASCII Char 13 found. Store in array "data2" 
    data2[BytesReceived] = 0; // add a 0 terminator
    Serial.println(data2);
  }


}

void MotorFWD(int steps){
  digitalWrite(Enmtr,LOW); //turn motor on
  digitalWrite(Dirmtr,LOW); // Set Direction of motor to Right
  for (k=0;k<steps;k++){
    digitalWrite(Stepmtr,LOW);
    delay(Speed);
    digitalWrite(Stepmtr,HIGH);
  }

}
void MotorRtrn(int steps){

  digitalWrite(Dirmtr,HIGH); //Set direction of motor to Left
  for (l=0;l<steps;l++){
    digitalWrite(Stepmtr,LOW);
    delay(Speed);
    digitalWrite(Stepmtr,HIGH);

  }
  digitalWrite(Enmtr,HIGH);//turn off motor
}



